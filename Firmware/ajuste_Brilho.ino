

//////////////////////////////////////////////////////////////////////////////////////////////////////////////
// mapeamento de hardware
#define luz A1

//////////////////////////////////////////////////////////////////////////////////////////////////////////////
// macros
#define ldrIluminacao analogRead(luz)

//////////////////////////////////////////////////////////////////////////////////////////////////////////////
// constants
const int brilhoReferencia = 0;
const int brilhoMin = 20;
const int brilhoMax = 255;

//////////////////////////////////////////////////////////////////////////////////////////////////////////////
// variáveis
int brilho = 255;
int tempo = 0;

//////////////////////////////////////////////////////////////////////////////////////////////////////////////
// prototipo Funções
int ajusteBrilho(int brilhoReferencia, int brilhoMin, int brilhoMax);
void contaTempo(int _tempo);

//////////////////////////////////////////////////////////////////////////////////////////////////////////////
// Confiruração
void setup() {
  pinMode(luz, INPUT);
  Serial.begin(9600);
  Serial.println("ajusteBrilho");
}

//////////////////////////////////////////////////////////////////////////////////////////////////////////////
// Loop Principal
void loop() {
  brilho = ajusteBrilho(brilhoReferencia, brilhoMin, brilhoMax);
  contaTempo(tempo);
}

//////////////////////////////////////////////////////////////////////////////////////////////////////////////
//Funçoes
int ajusteBrilho(int brilhoReferencia, int brilhoMin, int brilhoMax) {
  int brilhoAjustado = 0;
  static int ultimaBrilho = 0;
  static int flag = 0;
  const int tempoAlterar = 1000;

  brilhoAjustado = map(ldrIluminacao, 0, 1023, brilhoMin, brilhoMax);
  brilhoAjustado = round(brilhoAjustado / 50.0) * 50;

  if ((ultimaBrilho != brilhoAjustado) && (flag ==0)) {
    tempo = 0;
    flag = 1;
    Serial.println(brilhoAjustado + brilhoReferencia);
    ultimaBrilho = brilhoAjustado;
    return brilhoAjustado;
  }
  if (tempo == tempoAlterar) flag = 0;
}

/////////////////////////////////////////////////////////////////////////////////////////
void contaTempo(int _tempo) {
  static unsigned long lastTime1 = 0;
  unsigned long currentTime = millis();  // guarda o tempo atual

  if ((currentTime - lastTime1) >= 1) {
    lastTime1 = currentTime;
    tempo++;
  }
}
/////////////////////////////////////////////////////////////////////////////////////////